## components/lnconfig/Kconfig
```kconfig
menu "common component configuration"
    #rsource "../xbluetooth/Kconfig.in"
    #rsource "../xevent_loop/Kconfig.in"
    #rsource "../xlocal_storage/Kconfig.in"
    #rsource "../xwifi/Kconfig.in"
    #rsource "../xiot_client/Kconfig.in"
endmenu
```

## sdkconfig.defaults
```kconfig
CONFIG_IDF_TARGET="esp32c6"

CONFIG_PARTITION_TABLE_CUSTOM=y
CONFIG_PARTITION_TABLE_CUSTOM_FILENAME="module_config/partitions.csv"
CONFIG_PARTITION_TABLE_FILENAME="module_config/partitions.csv"

#CONFIG_BT_ENABLED=y
#CONFIG_BT_NIMBLE_ENABLED=y
#CONFIG_BT_CONTROLLER_ENABLED=y
#CONFIG_BT_NIMBLE_BLUFI_ENABLE=y

#CONFIG_COMPILER_OPTIMIZATION_SIZE=y

#CONFIG_ESP_WIFI_SOFTAP_SUPPORT=n

#CONFIG_ESP_SYSTEM_EVENT_TASK_STACK_SIZE=4096
#CONFIG_ESP_MAIN_TASK_STACK_SIZE=8192

#CONFIG_MBEDTLS_DHM_C=y
```

## sdkconfig.defaults.esp32s3
```kconfig
CONFIG_ESPTOOLPY_FLASHSIZE_4MB=y
CONFIG_ESPTOOLPY_FLASHSIZE="4MB"
CONFIG_ESP_DEFAULT_CPU_FREQ_MHZ_240=y

#CONFIG_ESP_WIFI_SOFTAP_SUPPORT=y
#CONFIG_ESP_WIFI_ESPNOW_MAX_ENCRYPT_NUM=2

#CONFIG_LWIP_IP_FORWARD=y
#CONFIG_LWIP_IPV4_NAPT=y
#CONFIG_LWIP_DHCPS_MAX_STATION_NUM=15

#CONFIG_BRIDGE_ENABLE=y
#CONFIG_BRIDGE_EXTERNAL_NETIF_STATION=y
#CONFIG_BRIDGE_DATA_FORWARDING_NETIF_SOFTAP=y

#CONFIG_BRIDGE_SOFTAP_MAX_CONNECT_NUMBER=15
```
